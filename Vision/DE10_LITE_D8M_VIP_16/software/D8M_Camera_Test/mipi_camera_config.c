/*
 * config_reg.c
 *
 *  Created on: 2015/3/27
 *      Author: User
 */

#include <stdio.h>
#include "I2C_core.h"
#include "terasic_includes.h"
#include "system.h"
#include "mipi_camera_config.h"
#include "auto_focus.h"




#define Sleep(x)	usleep(x*1000)
#define OV8865DB(x) printf(x)

typedef struct{
	alt_u8 Type;
	alt_u16 Addr;
	alt_u8 Data;
}SZ_CONFIG_T;


#define REG_8BIT 1
#define REG_16BIT 2
#define TIME_DELAY 3
#define END_OF_SCRIPT 4

static SZ_CONFIG_T MipiCameraReg[] = {
	     {0x6c,0x0103, 0x01}, // software reset
	  		{TIME_DELAY, 0, 10},
	     {0x6c,0x0100, 0x00}, // software standby
	     {0x6c,0x0100, 0x00}, // software standby
	     {0x6c,0x0100, 0x00}, // software standby
	     {0x6c,0x0100, 0x00}, // software standby
	  		{TIME_DELAY, 0, 10},

	     {0x6c,0x3638, 0xff}, // analog control
  // 25MHz MCLK input
  // PHY_CLK : 600 MHz (data rate,not clock rate)
  // PCLK    : 75  MHz
  // SCLK    : 150 MHz
	     {0x6c,0x0302, 24}, // PLL pll1_multiplier
	     {0x6c,0x0303, 0x00}, // PLL pll1_divm1+pll1_divm
	     {0x6c,0x0304, 3}, // PLL pll1_div_mipi
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	     {0x6c,0x364a, 0x1b}, // MIPI settings

	     // exposure
//	     {0x6c,0x3500, 0x00}, // exposure HH
	     {0x6c,0x3501, 0x18}, // exposure H
//	     {0x6c,0x3502, 0x60}, // exposure L
	     {0x6c,0x3500, 0x00}, // exposure HH
	     {0x6c,0x3501, 0x2C}, // exposure H
	     {0x6c,0x3502, 0x00}, // exposure L
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	     {0x6c,0x37b9, 0xff}, // sensor control
	     // don't care , use auto size
//	     {0x6c,0x3800, 0x00}, // X start H
//	     {0x6c,0x3801, 0x0c}, // X start L
//	     {0x6c,0x3802, 0x00}, // Y start H
//	     {0x6c,0x3803, 0x0c}, // Y start L
//	     {0x6c,0x3804, 0x0c}, // X end H
//	     {0x6c,0x3805, 0xd3}, // X end L
//	     {0x6c,0x3806, 0x09}, // Y end H
//	     {0x6c,0x3807, 0xa3}, // Y end L


//	     // 800x600
//	     {0x6c,0x3808, 0x03}, // X output size H
//	     {0x6c,0x3809, 0x20}, // X output size L
//	     {0x6c,0x380a, 0x02}, // Y output size H
//	     {0x6c,0x380b, 0x58}, // Y output size L

	     // 640x480
	     {0x6c,0x3808, 0x02}, // X output size H
	     {0x6c,0x3809, 0x80}, // X output size L
	     {0x6c,0x380a, 0x01}, // Y output size H
	     {0x6c,0x380b, 0xE0}, // Y output size L



	     // 60 fps (combined with pll settings)
	     {0x6c,0x380c, 0x12}, // HTS H
	     {0x6c,0x380d, 0x00}, // HTS L
	     {0x6c,0x380e, 0x02}, // VTS H
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	     {0x6c,0x4601, 0x10}, // V FIFO control

	     // clock prepare  50+ Tui*ui_clk_prepare_min(0) : 50 ns
	     {0x6c,0x481f, 70}, // clk_prepare_min

	     {0x6c,0x4837, 0x16}, // clock period
	     {0x6c,0x4850, 0x10}, // lane select
	     {0x6c,0x4851, 0x32}, // lane select
	     {0x6c,0x4b00, 0x2a}, // LVDS settings
	     {0x6c,0x4b0d, 0x00}, // LVDS settings
	     {0x6c,0x4d00, 0x04}, // temperature sensor
	     {0x6c,0x4d01, 0x18}, // temperature sensor
	     {0x6c,0x4d02, 0xc3}, // temperature sensor
	     {0x6c,0x4d03, 0xff}, // temperature sensor
	     {0x6c,0x4d04, 0xff}, // temperature sensor
	     {0x6c,0x4d05, 0xff}, // temperature sensor
	     {0x6c,0x5000, 0x16}, // LENC on, MWB on, BPC on, WPC on
	     {0x6c,0x5001, 0x01}, // BLC on
	     {0x6c,0x5002, 0x08}, // vario pixel off
	     {0x6c,0x5901, 0x00},

	     {0x6c,0x5e00, 0x00}, // test pattern off


	     {0x6c,0x5018, 0x15}, // Red MWB gain
	     {0x6c,0x501A, 0x10}, // Green MWB gain
	     {0x6c,0x501C, 0x15}, // Blue MWB gain


#if 0  // test pattern
	     {0x6c,0x5e00, 0x82}, // test pattern on
#endif
	     {0x6c,0x5e01, 0x41}, // window cut enable


	     {TIME_DELAY, 0, 10},

	     {0x6c,0x5780, 0xfc},
	     {0x6c,0x5781, 0xdf},
	     {0x6c,0x5782, 0x3f},
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	     {0x6c,0x0100, 0x01}, //; wake up, streaming

	     {END_OF_SCRIPT, 0, 0}
   };




alt_u8 OV8865_read_cmos_sensor_8(alt_u16 Addr){
	const alt_u8 device_address = MIPI_I2C_ADDR;
	alt_u8 Value;

	//OC_I2CL_Write(I2C_OPENCORES_CAMERA_BASE, device_address, SWAP16(Addr), (alt_u8 *)&Value, sizeof(Value));
	OC_I2CL_Read(I2C_OPENCORES_CAMERA_BASE, device_address, Addr, (alt_u8 *)&Value, sizeof(Value));

	return (Value);
}


void OV8865_write_cmos_sensor_8(alt_u16 Addr, alt_u8 Value){
	const alt_u8 device_address = MIPI_I2C_ADDR;
	//OC_I2CL_Write(I2C_OPENCORES_CAMERA_BASE, device_address, SWAP16(Addr), (alt_u8 *)&Value, sizeof(Value));
	OC_I2CL_Write(I2C_OPENCORES_CAMERA_BASE, device_address, Addr, (alt_u8 *)&Value, sizeof(Value));
}


void OV8865_write_AF(alt_u8 msb, alt_u8 lsb){
	// VCM149C
	const alt_u8 device_address = MIPI_AF_I2C_ADDR;
	OC_I2C_Write(I2C_OPENCORES_CAMERA_BASE, device_address, msb, (alt_u8 *)&lsb, sizeof(lsb));
}

void OV8865_read_AF(void){
	// VCM149C
	const alt_u8 device_address = MIPI_AF_I2C_ADDR;
	alt_u8 szData8[2];
	bool bSuccess;

		bSuccess = OC_I2C_Read_Continue(I2C_OPENCORES_CAMERA_BASE, device_address, szData8, sizeof(szData8));
		if (bSuccess)
			printf("Read MSB=%xh, LSB=%xh\r\n", szData8[0], szData8[1]);
}

void OV8865_FOCUS_Move_to(alt_u16 a_u2MovePosition)
{
  if (a_u2MovePosition > 1023)   {a_u2MovePosition = 1023;}
  if (a_u2MovePosition < 0)     {a_u2MovePosition = 0;}
  int bSuccess;

  Focus_Released(); // waiting for VCM release I2C bus

	bSuccess = oc_i2c_init_ex(I2C_OPENCORES_CAMERA_BASE, 50*1000*1000,400*1000); //I2C: 400K
	if (!bSuccess)
		printf("failed to init MIPI- Camera i2c\r\n");

	//printf("Manual set focus to %d\r\n",a_u2MovePosition);
  alt_u8 msb,lsb;
  msb = (a_u2MovePosition >> 4)&0x00FF;
  lsb = (a_u2MovePosition << 4 )&0x00F0;
  lsb += 0x06;
//	printf("Write MSB=%xh, LSB=%xh\r\n", msb, lsb);
	OV8865_write_AF(msb, lsb+0x6);
	usleep(1000);
//	OV8865_read_AF();

	oc_i2c_uninit(I2C_OPENCORES_CAMERA_BASE);  // Release I2C bus , due to two I2C master shared!

}

void OV8865SetExposure(alt_u32 exposure){

	Focus_Released(); // waiting for VCM release I2C bus

	int bSuccess = oc_i2c_init_ex(I2C_OPENCORES_CAMERA_BASE, 50*1000*1000,400*1000); //I2C: 400K
	if (!bSuccess)
		printf("failed to init MIPI- Camera i2c\r\n");

	if (exposure > 0xFFFFF) exposure = 0xFFFFF;
	if (exposure < 0x20) exposure = 0x20;

	OV8865_write_cmos_sensor_8(0x3500, (exposure >> 16) & 0x0F);
	OV8865_write_cmos_sensor_8(0x3501, (exposure >> 8) & 0xFF);
	OV8865_write_cmos_sensor_8(0x3502, exposure & 0xFF);


	oc_i2c_uninit(I2C_OPENCORES_CAMERA_BASE);
}

void OV8865SetGain(alt_u16 gain){

	Focus_Released(); // waiting for VCM release I2C bus

	int bSuccess = oc_i2c_init_ex(I2C_OPENCORES_CAMERA_BASE, 50*1000*1000,400*1000); //I2C: 400K
	if (!bSuccess)
		printf("failed to init MIPI- Camera i2c\r\n");

	if (gain > 0x7FF) gain = 0x7FF;
	if (gain < 0x080) gain = 0x080;

	OV8865_write_cmos_sensor_8(0x3508, (gain >> 8) & 0x0F);
	OV8865_write_cmos_sensor_8(0x3509, gain & 0xFF);


	oc_i2c_uninit(I2C_OPENCORES_CAMERA_BASE);
}

alt_u32 OV8865ReadExposure(){

	alt_u32 exposure;

	Focus_Released(); // waiting for VCM release I2C bus

	int bSuccess = oc_i2c_init_ex(I2C_OPENCORES_CAMERA_BASE, 50*1000*1000,400*1000); //I2C: 400K
	if (!bSuccess)
		printf("failed to init MIPI- Camera i2c\r\n");

	exposure = OV8865_read_cmos_sensor_8(0x3500);
	exposure = (exposure <<8) | OV8865_read_cmos_sensor_8(0x3501);
	exposure = (exposure <<8) | OV8865_read_cmos_sensor_8(0x3502);

	oc_i2c_uninit(I2C_OPENCORES_CAMERA_BASE);

	return exposure;
}




//ZOOM
void MIPI_BIN_LEVEL(alt_u8 level){
	if(level <= 1) level = 1;
	if(level >= 3) level = 3;

	  Focus_Released(); // waiting for VCM release I2C bus

	  int bSuccess;
		bSuccess = oc_i2c_init_ex(I2C_OPENCORES_CAMERA_BASE, 50*1000*1000,400*1000); //I2C: 400K
		if (!bSuccess)
			printf("failed to init MIPI- Camera i2c\r\n");


	OV8865_write_cmos_sensor_8(0x0100, 0x00);

	if(level == 1){

		OV8865_write_cmos_sensor_8(0x3814, 0x01);
		OV8865_write_cmos_sensor_8(0x3815, 0x01);
		OV8865_write_cmos_sensor_8(0x382a, 0x01);
		OV8865_write_cmos_sensor_8(0x382b, 0x01);

		OV8865_write_cmos_sensor_8(0x3830, 8);
		OV8865_write_cmos_sensor_8(0x3836, 2);
	}
	else if(level == 2){

		OV8865_write_cmos_sensor_8(0x3814, 0x03);
		OV8865_write_cmos_sensor_8(0x3815, 0x01);
		OV8865_write_cmos_sensor_8(0x382a, 0x03);
		OV8865_write_cmos_sensor_8(0x382b, 0x01);

		OV8865_write_cmos_sensor_8(0x3830, 4);
		OV8865_write_cmos_sensor_8(0x3836, 1);

	}
	else if(level == 3){

		OV8865_write_cmos_sensor_8(0x3814, 0x07);
		OV8865_write_cmos_sensor_8(0x3815, 0x01);
		OV8865_write_cmos_sensor_8(0x382a, 0x07);
		OV8865_write_cmos_sensor_8(0x382b, 0x01);

		OV8865_write_cmos_sensor_8(0x3830, 8);
		OV8865_write_cmos_sensor_8(0x3836, 2);
	}
    usleep(10000);
	OV8865_write_cmos_sensor_8(0x0100, 0x01);

	oc_i2c_uninit(I2C_OPENCORES_CAMERA_BASE);  // Release I2C bus , due to two I2C master shared!

}
//
//
//void BLC_LEVEL(alt_u8 blc0,alt_u8 blc1){
//	if(blc0 < 1) blc0 = 0;
//	if(blc0 >= 31) blc0 = 31;
//
//	if(blc1 < 1) blc1 = 0;
//	if(blc1 >= 31) blc1 = 31;
//
//        printf("BLC0 %d ,BLC1 %d \n",blc0,blc1);
//        OV8865_write_cmos_sensor_8(0x0100, 0x00);
//
//		OV8865_write_cmos_sensor_8(0x3830, blc0);
//		OV8865_write_cmos_sensor_8(0x3836, blc1);
//
//	    usleep(10000);
//		OV8865_write_cmos_sensor_8(0x0100, 0x01);
//}


void MipiCameraInit(void)
{

    int i, num;
    int bSuccess;

    Focus_Released(); // waiting for VCM release I2C bus


		bSuccess = oc_i2c_init_ex(I2C_OPENCORES_CAMERA_BASE, 50*1000*1000,400*1000); //I2C: 400K
		if (!bSuccess)
			printf("failed to init MIPI- Camera i2c\r\n");

//  searching for active I2C address.
//    int ii;
//    for(ii= 0; ii<256;ii++){
//    	printf("%x:  ",ii);
//    	alt_u8 data = 0x30;
//        OC_I2C_Write(I2C_OPENCORES_CAMERA_BASE, ii, 0x30,  (alt_u8 *)&data, 1);
//        usleep(10000);
//    }
//


	 OV8865DB("\nStart MipiCameraInit -OV8865!\r\n");
	 OV8865DB("Write Read Test!\n");

	    for(i=0;i<10;i++){
	       OV8865_write_cmos_sensor_8(0x3809,i);
	      usleep(100);
	        printf("%d (%d)\n",OV8865_read_cmos_sensor_8(0x3809),i);
	      usleep(100);
	    }
	 num = sizeof(MipiCameraReg)/sizeof(MipiCameraReg[0]);
     for(i=0;i<num;i++){

    	 if (MipiCameraReg[i].Type == TIME_DELAY)   usleep(MipiCameraReg[i].Data*100);
    	 else if(MipiCameraReg[i].Type == END_OF_SCRIPT)   break;
    	 else if(MipiCameraReg[i].Type == 0x6c)   OV8865_write_cmos_sensor_8(MipiCameraReg[i].Addr, MipiCameraReg[i].Data);
     }


 	oc_i2c_uninit(I2C_OPENCORES_CAMERA_BASE);  // Release I2C bus , due to two I2C master shared!



	 OV8865DB("\nEnd MipiCameraInit! -OV8865!\r\n\n");

}






